#include "stm32l4xx.h"

//-------------------------------------------------------------------
#if !defined  (HSE_STARTUP_TIMEOUT)
  #define HSE_STARTUP_TIMEOUT  (0x05000)  //!< Time out for HSE start up
#endif

#define DWORD uint32_t

//*******************************************************************
/*!
This function is a summary of "system_stm32f4xx.c" generated by
"STM32L1xx_Clock_Configuration_V1.1.0.xls"

\see STMicroelectronics, AN3309 Clock configuration tool for
STM32L1xx microcontrollers, Doc ID 18200 Rev 2, January 2012
*/
void SystemInit( void )
{
  // Set FPU
  #if (__FPU_PRESENT == 1) && (__FPU_USED == 1)

    // System Control Block (SCB), Coprocessor Access Control Register
    SCB->CPACR |=   (3UL << 10*2)  // CP10: Full access
                  | (3UL << 11*2); // CP11: Full access

  #endif

  // Clock control register
  RCC->CR |= RCC_CR_MSION;

  // Clock configuration register
  RCC->CFGR = 0x00000000;       // reset ...

  // Clock control register
  RCC->CR &= ~(   RCC_CR_PLLON  // reset ...
                | RCC_CR_CSSON
                | RCC_CR_HSEON
                | RCC_CR_HSION );

  // PLL configuration register
  RCC->PLLCFGR = 0x00001000;   // Reset value,
                               // see Reference manual

  // Clock control register
  RCC->CR &= ~(RCC_CR_HSEBYP); // reset ...

  // Clock interrupt register
  RCC->CIER = 0;                // Disable all interrupts

  //-----------------------------------------------------------------
//  #if defined (_HSE_BYPASS_ON )
//    RCC->CR |= (RCC_CR_HSEON | RCC_CR_HSEBYP);
//  #elif defined (_HSE_BYPASS_OFF )
//    RCC->CR |= (RCC_CR_HSEON );
//  #else
//    #error "_HSE_BYPASS not defined"
//  #endif

  //-----------------------------------------------------------------
  //! \todo Check code
  // Clock control register
  RCC->CR |= RCC_CR_MSION;   // Need HSION in ADC (only?)

  // Wait until MSI is ready or timeout
  for( unsigned i = 0; i < HSE_STARTUP_TIMEOUT; i++ )
  {
    if( RCC->CR & RCC_CR_MSIRDY )
      break;
  }

  if( RCC->CR & RCC_CR_MSIRDY )
  {
    // Flash Acess Control Register
    FLASH->ACR =   FLASH_ACR_ICEN          // Instruction cache enable
                 | FLASH_ACR_DCEN          // Data cache enable
                 | FLASH_ACR_LATENCY_4WS;  // Latency: 4 wait states

    // Advanced Peripheral Bus Enable Register
    RCC->APB1ENR1 |= RCC_APB1ENR1_PWREN;    // Power interface clock: enable

    // Clock Configuration Register
    //! \todo Check clock configuration
    RCC->CFGR |=   RCC_CFGR_HPRE_DIV1     // AHB prescaler:                   HCLK  = SYSCLK
                 | RCC_CFGR_PPRE2_DIV1    // APB high-speed prescaler (APB2): PCLK2 = HCLK/1
                                          //   PCLK2 must not exceed 84 MHz
                 | RCC_CFGR_PPRE1_DIV1;   // APB low-speed  prescaler (APB1): PCLK1 = HCLK/1
                                          //   PCLK1 must not exceed 42 MHz

    //---------------------------------------------------------------
    /* PLL configuration

       f_osc  +----+ f_in  +-----+ f_out      +----+   f_pllsai1clk
       ------>| /M |------>| VCO |--+------+->| /P |---------->
              +----+    +->|     |  |      |  +----+
                        |  +-----+  |      |
                        |           |      |  +----+   f_pll48m1clk
                        |  +----+   |      +->| /Q |----------->
                        +--| *N |<--+      |  +----+
                           +----+          |
                                           |  +----+   f_pllclk
                                           +->| /R |----------->
                                              +----+
        f_osc: HSI16 or HSE or MSI
        f_in          = f_osc / M (range:   4 to  16MHz, M = 1,...,8)
        f_out         = f_in  * N (range:  64 to 344MHz, N = 8,...,86)
        f_pllsai1clk  = f_out / P (range:  up to  80MHz, P = 2,3,..,31)
        f_pll48m1clk  = f_out / Q (equal to 48 MHz,      Q = 2,4,6,8)
        f_pllclk      = f_out / R (range: up to 80 MHz,  R = 2,..., 15)

        Allowed frequencies due to f_pll48ck:
        f_out = 96, 192, 288, 384
            Q =  2    4    6    8
    */
    //---------------------------------------------------------------

    const DWORD pll_M =  1; ///(_MSI_CLK)/1000UL; // -> f_in         =     4 MHz
    const DWORD pll_N = 72; ///336;               // -> f_out        =  72*4 MHz = 288 MHz
    const DWORD pll_P =  4; ///4;                 // -> f_pllsai1clk = 288/4 MHz =  72 MHz
    const DWORD pll_Q =  6; ///7;                 // -> f_pll48m1clk = 288/6 MHz =  48 MHz
    const DWORD pll_R =  4; ///7;                 // -> f_pllclk     = 288/4 MHz =  72 MHz

    // PLL configuration register
    RCC->PLLCFGR =   RCC_PLLCFGR_PLLSRC_MSI
                   | RCC_PLLCFGR_PLLPEN
                   | RCC_PLLCFGR_PLLQEN
                   | RCC_PLLCFGR_PLLREN
                   | ( (pll_M-1)      <<  4 )
                   | ( (pll_N  )      <<  8 )
                   | ( (pll_P)        << 27 )
                   | ( (pll_Q/2-1)    << 21 )
                   | ( (pll_R/2-1)    << 25 );

    // Clock control register
    RCC->CR |= RCC_CR_PLLON;            // PLL enable: ON
    while( !(RCC->CR & RCC_CR_PLLRDY) );// Wait until PLL is ready

    // Clock Configuration Register
    RCC->CFGR &= ~RCC_CFGR_SW;          // reset system clock switch
    RCC->CFGR |=  RCC_CFGR_SW_PLL;      // System clock switch:
                                        //  PLL selected as system clock

    // Wait for system clock switch is ready
    while( (RCC->CFGR & RCC_CFGR_SWS) != RCC_CFGR_SWS_PLL );

  }
  else
  {
    // Error: Wrong clock configuration
  }

  // System Control Block
  SCB->VTOR = FLASH_BASE | 0x00; // Vector Table Relocation in internal FLASH

}

//EOF
